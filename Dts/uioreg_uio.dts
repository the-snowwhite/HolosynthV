/dts-v1/ /plugin/;

/ {
   fragment@0 {
      target-path = "/soc/base_fpga_region";
		#address-cells = <1>;
		#size-cells = <1>;
      __overlay__ {
			#address-cells = <1>;
			#size-cells = <1>;

			ranges = <0x00040000 0xff240000 0x00010000>;
			firmware-name = "socfpga/socfpga.rbf";

			uioreg_io_0: uio-socfpga@0x40000 {
				compatible = "htrnic,uioreg-io-1.0";
				reg = <0x40000 0x10000>;
				clocks = <&osc1>;
				address_width = <14>;
				data_width = <32>;
			};
		};
	};
};

