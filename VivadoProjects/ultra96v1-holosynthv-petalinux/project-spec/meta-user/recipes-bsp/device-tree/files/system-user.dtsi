/include/ "system-conf.dtsi"
/ {
};
    &holosynth_uio {
    compatible = "generic-uio";
    address_width = <16>;
    data_width = <32>;
};
    &holosynth_midi {
    compatible = "holotr,socsynth-midi";
    address_width = <3>;
    data_width = <8>;
};
    &holosynth_audio {
    compatible = "generic-uio";
    address_width = <2>;
    data_width = <32>;
};
